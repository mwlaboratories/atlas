## zmk-workspace-ble/build/right/Kconfig/soc/Kconfig.soc
```kconfig
# Load SoC Kconfig descriptions.
osource "/home/gomar/Documents/repos/atlas/zmk-workspace-ble/zephyr/soc/xlnx/zynqmp/Kconfig.soc"
osource "/home/gomar/Documents/repos/atlas/zmk-workspace-ble/zephyr/soc/xlnx/zynq7000/Kconfig.soc"
osource "/home/gomar/Documents/repos/atlas/zmk-workspace-ble/zephyr/soc/xen/Kconfig.soc"
osource "/home/gomar/Documents/repos/atlas/zmk-workspace-ble/zephyr/soc/wch/ch32v/Kconfig.soc"
osource "/home/gomar/Documents/repos/atlas/zmk-workspace-ble/zephyr/soc/ti/simplelink/Kconfig.soc"
osource "/home/gomar/Documents/repos/atlas/zmk-workspace-ble/zephyr/soc/ti/lm3s6965/Kconfig.soc"
osource "/home/gomar/Documents/repos/atlas/zmk-workspace-ble/zephyr/soc/ti/k3/Kconfig.soc"
osource "/home/gomar/Documents/repos/atlas/zmk-workspace-ble/zephyr/soc/telink/tlsr/Kconfig.soc"
osource "/home/gomar/Documents/repos/atlas/zmk-workspace-ble/zephyr/soc/starfive/jh71xx/Kconfig.soc"
osource "/home/gomar/Documents/repos/atlas/zmk-workspace-ble/zephyr/soc/st/stm32/Kconfig.soc"
osource "/home/gomar/Documents/repos/atlas/zmk-workspace-ble/zephyr/soc/snps/qemu_arc/Kconfig.soc"
osource "/home/gomar/Documents/repos/atlas/zmk-workspace-ble/zephyr/soc/snps/nsim/arc_v/Kconfig.soc"
osource "/home/gomar/Documents/repos/atlas/zmk-workspace-ble/zephyr/soc/snps/nsim/arc_classic/Kconfig.soc"
osource "/home/gomar/Documents/repos/atlas/zmk-workspace-ble/zephyr/soc/snps/hsdk4xd/Kconfig.soc"
osource "/home/gomar/Documents/repos/atlas/zmk-workspace-ble/zephyr/soc/snps/hsdk/Kconfig.soc"
osource "/home/gomar/Documents/repos/atlas/zmk-workspace-ble/zephyr/soc/snps/emsk/Kconfig.soc"
osource "/home/gomar/Documents/repos/atlas/zmk-workspace-ble/zephyr/soc/snps/emsdp/Kconfig.soc"
osource "/home/gomar/Documents/repos/atlas/zmk-workspace-ble/zephyr/soc/snps/arc_iot/Kconfig.soc"
osource "/home/gomar/Documents/repos/atlas/zmk-workspace-ble/zephyr/soc/silabs/Kconfig.soc"
osource "/home/gomar/Documents/repos/atlas/zmk-workspace-ble/zephyr/soc/sifive/sifive_freedom/Kconfig.soc"
osource "/home/gomar/Documents/repos/atlas/zmk-workspace-ble/zephyr/soc/sensry/Kconfig.soc"
osource "/home/gomar/Documents/repos/atlas/zmk-workspace-ble/zephyr/soc/rockchip/Kconfig.soc"
osource "/home/gomar/Documents/repos/atlas/zmk-workspace-ble/zephyr/soc/renode/riscv_virtual/Kconfig.soc"
osource "/home/gomar/Documents/repos/atlas/zmk-workspace-ble/zephyr/soc/renode/cortex_r8_virtual/Kconfig.soc"
osource "/home/gomar/Documents/repos/atlas/zmk-workspace-ble/zephyr/soc/renesas/smartbond/Kconfig.soc"
osource "/home/gomar/Documents/repos/atlas/zmk-workspace-ble/zephyr/soc/renesas/rzt2m/Kconfig.soc"
osource "/home/gomar/Documents/repos/atlas/zmk-workspace-ble/zephyr/soc/renesas/rz/Kconfig.soc"
osource "/home/gomar/Documents/repos/atlas/zmk-workspace-ble/zephyr/soc/renesas/rcar/Kconfig.soc"
osource "/home/gomar/Documents/repos/atlas/zmk-workspace-ble/zephyr/soc/renesas/ra/Kconfig.soc"
osource "/home/gomar/Documents/repos/atlas/zmk-workspace-ble/zephyr/soc/realtek/ec/Kconfig.soc"
osource "/home/gomar/Documents/repos/atlas/zmk-workspace-ble/zephyr/soc/raspberrypi/rpi_pico/Kconfig.soc"
osource "/home/gomar/Documents/repos/atlas/zmk-workspace-ble/zephyr/soc/quicklogic/eos_s3/Kconfig.soc"
osource "/home/gomar/Documents/repos/atlas/zmk-workspace-ble/zephyr/soc/qemu/virt_riscv/Kconfig.soc"
osource "/home/gomar/Documents/repos/atlas/zmk-workspace-ble/zephyr/soc/qemu/malta/Kconfig.soc"
osource "/home/gomar/Documents/repos/atlas/zmk-workspace-ble/zephyr/soc/openisa/rv32m1/Kconfig.soc"
osource "/home/gomar/Documents/repos/atlas/zmk-workspace-ble/zephyr/soc/nxp/s32/Kconfig.soc"
osource "/home/gomar/Documents/repos/atlas/zmk-workspace-ble/zephyr/soc/nxp/rw/Kconfig.soc"
osource "/home/gomar/Documents/repos/atlas/zmk-workspace-ble/zephyr/soc/nxp/mcx/Kconfig.soc"
osource "/home/gomar/Documents/repos/atlas/zmk-workspace-ble/zephyr/soc/nxp/lpc/Kconfig.soc"
osource "/home/gomar/Documents/repos/atlas/zmk-workspace-ble/zephyr/soc/nxp/layerscape/Kconfig.soc"
osource "/home/gomar/Documents/repos/atlas/zmk-workspace-ble/zephyr/soc/nxp/kinetis/Kconfig.soc"
osource "/home/gomar/Documents/repos/atlas/zmk-workspace-ble/zephyr/soc/nxp/imxrt/Kconfig.soc"
osource "/home/gomar/Documents/repos/atlas/zmk-workspace-ble/zephyr/soc/nxp/imx/Kconfig.soc"
osource "/home/gomar/Documents/repos/atlas/zmk-workspace-ble/zephyr/soc/nuvoton/numicro/Kconfig.soc"
osource "/home/gomar/Documents/repos/atlas/zmk-workspace-ble/zephyr/soc/nuvoton/numaker/Kconfig.soc"
osource "/home/gomar/Documents/repos/atlas/zmk-workspace-ble/zephyr/soc/nuvoton/npcx/Kconfig.soc"
osource "/home/gomar/Documents/repos/atlas/zmk-workspace-ble/zephyr/soc/nuvoton/npcm/Kconfig.soc"
osource "/home/gomar/Documents/repos/atlas/zmk-workspace-ble/zephyr/soc/nordic/Kconfig.soc"
osource "/home/gomar/Documents/repos/atlas/zmk-workspace-ble/zephyr/soc/neorv32/Kconfig.soc"
osource "/home/gomar/Documents/repos/atlas/zmk-workspace-ble/zephyr/soc/native/inf_clock/Kconfig.soc"
osource "/home/gomar/Documents/repos/atlas/zmk-workspace-ble/zephyr/soc/microchip/miv/Kconfig.soc"
osource "/home/gomar/Documents/repos/atlas/zmk-workspace-ble/zephyr/soc/microchip/mec/Kconfig.soc"
osource "/home/gomar/Documents/repos/atlas/zmk-workspace-ble/zephyr/soc/mediatek/mt8xxx/Kconfig.soc"
osource "/home/gomar/Documents/repos/atlas/zmk-workspace-ble/zephyr/soc/lowrisc/opentitan/Kconfig.soc"
osource "/home/gomar/Documents/repos/atlas/zmk-workspace-ble/zephyr/soc/litex/litex_vexriscv/Kconfig.soc"
osource "/home/gomar/Documents/repos/atlas/zmk-workspace-ble/zephyr/soc/ite/ec/Kconfig.soc"
osource "/home/gomar/Documents/repos/atlas/zmk-workspace-ble/zephyr/soc/intel/raptor_lake/Kconfig.soc"
osource "/home/gomar/Documents/repos/atlas/zmk-workspace-ble/zephyr/soc/intel/lakemont/Kconfig.soc"
osource "/home/gomar/Documents/repos/atlas/zmk-workspace-ble/zephyr/soc/intel/intel_socfpga_std/Kconfig.soc"
osource "/home/gomar/Documents/repos/atlas/zmk-workspace-ble/zephyr/soc/intel/intel_socfpga/Kconfig.soc"
osource "/home/gomar/Documents/repos/atlas/zmk-workspace-ble/zephyr/soc/intel/intel_niosv/Kconfig.soc"
osource "/home/gomar/Documents/repos/atlas/zmk-workspace-ble/zephyr/soc/intel/intel_ish/Kconfig.soc"
osource "/home/gomar/Documents/repos/atlas/zmk-workspace-ble/zephyr/soc/intel/intel_adsp/Kconfig.soc"
osource "/home/gomar/Documents/repos/atlas/zmk-workspace-ble/zephyr/soc/intel/elkhart_lake/Kconfig.soc"
osource "/home/gomar/Documents/repos/atlas/zmk-workspace-ble/zephyr/soc/intel/atom/Kconfig.soc"
osource "/home/gomar/Documents/repos/atlas/zmk-workspace-ble/zephyr/soc/intel/apollo_lake/Kconfig.soc"
osource "/home/gomar/Documents/repos/atlas/zmk-workspace-ble/zephyr/soc/intel/alder_lake/Kconfig.soc"
osource "/home/gomar/Documents/repos/atlas/zmk-workspace-ble/zephyr/soc/infineon/cat3/Kconfig.soc"
osource "/home/gomar/Documents/repos/atlas/zmk-workspace-ble/zephyr/soc/infineon/cat1b/Kconfig.soc"
osource "/home/gomar/Documents/repos/atlas/zmk-workspace-ble/zephyr/soc/infineon/cat1a/Kconfig.soc"
osource "/home/gomar/Documents/repos/atlas/zmk-workspace-ble/zephyr/soc/gd/gd32/Kconfig.soc"
osource "/home/gomar/Documents/repos/atlas/zmk-workspace-ble/zephyr/soc/gaisler/leon3/Kconfig.soc"
osource "/home/gomar/Documents/repos/atlas/zmk-workspace-ble/zephyr/soc/gaisler/gr716a/Kconfig.soc"
osource "/home/gomar/Documents/repos/atlas/zmk-workspace-ble/zephyr/soc/espressif/Kconfig.soc"
osource "/home/gomar/Documents/repos/atlas/zmk-workspace-ble/zephyr/soc/ene/kb1200/Kconfig.soc"
osource "/home/gomar/Documents/repos/atlas/zmk-workspace-ble/zephyr/soc/efinix/sapphire/Kconfig.soc"
osource "/home/gomar/Documents/repos/atlas/zmk-workspace-ble/zephyr/soc/cdns/xtensa_sample_controller/Kconfig.soc"
osource "/home/gomar/Documents/repos/atlas/zmk-workspace-ble/zephyr/soc/cdns/sample_controller32/Kconfig.soc"
osource "/home/gomar/Documents/repos/atlas/zmk-workspace-ble/zephyr/soc/cdns/dc233c/Kconfig.soc"
osource "/home/gomar/Documents/repos/atlas/zmk-workspace-ble/zephyr/soc/brcm/bcmvk/Kconfig.soc"
osource "/home/gomar/Documents/repos/atlas/zmk-workspace-ble/zephyr/soc/brcm/bcm2712/Kconfig.soc"
osource "/home/gomar/Documents/repos/atlas/zmk-workspace-ble/zephyr/soc/brcm/bcm2711/Kconfig.soc"
osource "/home/gomar/Documents/repos/atlas/zmk-workspace-ble/zephyr/soc/atmel/sam0/Kconfig.soc"
osource "/home/gomar/Documents/repos/atlas/zmk-workspace-ble/zephyr/soc/atmel/sam/Kconfig.soc"
osource "/home/gomar/Documents/repos/atlas/zmk-workspace-ble/zephyr/soc/aspeed/Kconfig.soc"
osource "/home/gomar/Documents/repos/atlas/zmk-workspace-ble/zephyr/soc/arm/Kconfig.soc"
osource "/home/gomar/Documents/repos/atlas/zmk-workspace-ble/zephyr/soc/arm/beetle/Kconfig.soc"
osource "/home/gomar/Documents/repos/atlas/zmk-workspace-ble/zephyr/soc/antmicro/myra/Kconfig.soc"
osource "/home/gomar/Documents/repos/atlas/zmk-workspace-ble/zephyr/soc/andestech/Kconfig.soc"
osource "/home/gomar/Documents/repos/atlas/zmk-workspace-ble/zephyr/soc/amd/acp_6_0/Kconfig.soc"
osource "/home/gomar/Documents/repos/atlas/zmk-workspace-ble/zephyr/soc/ambiq/Kconfig.soc"
osource "/home/gomar/Documents/repos/atlas/zmk-workspace-ble/zephyr/soc/altr/zephyr_nios2f/Kconfig.soc"
osource "/home/gomar/Documents/repos/atlas/zmk-workspace-ble/zephyr/soc/altr/qemu_nios2/Kconfig.soc"
osource "/home/gomar/Documents/repos/atlas/zmk-workspace-ble/zephyr/soc/adi/max32/Kconfig.soc"
```

## zmk-workspace-ble/config/west.yml
```yaml
manifest:
  remotes:
    - name: zmkfirmware
      url-base: https://github.com/zmkfirmware
    - name: badjeff
      url-base: https://github.com/badjeff
    - name: zzeneg
      url-base: https://github.com/zzeneg

  projects:
    - name: zmk
      remote: zmkfirmware
      revision: main
      import: app/west.yml
    - name: kb_zmk_ps2_mouse_trackpoint_driver
      remote: badjeff
      revision: 2df4d6d0d305ed121b1efbf0a028b44b174dccc7
    # Raw-HID transport for the strata layer reporter (zmk-strata/, local).
    - name: zmk-raw-hid
      remote: zzeneg
      revision: main

  self:
    path: config
```

## zmk-workspace-ble/zmk-laymap/Kconfig
```kconfig
config LAYMAP_LAYER_REPORT
    bool "Broadcast the active ZMK layer to the host over raw HID (laymap)"
    depends on RAW_HID
    help
      Subscribe to layer state changes and send a raw-HID report to the host
      on every change, so the laymap desktop overlay can display the active
      layer. Requires the zmk-raw-hid module (CONFIG_RAW_HID).

      Report framing (inside the CONFIG_RAW_HID_REPORT_SIZE-byte payload):
        byte 0   : 0x4C ('L') message type
        byte 1   : highest active layer index (0 = base)
        bytes 2-5: active-layer bitmask, u32 little-endian
        rest     : zero
```
