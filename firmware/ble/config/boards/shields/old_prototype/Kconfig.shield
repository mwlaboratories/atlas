## zmk-workspace-ble/build/right/Kconfig/Kconfig.modules
```kconfig
menu "kb_zmk_ps2_mouse_trackpoint_driver (/home/gomar/Documents/repos/atlas/zmk-workspace-ble/kb_zmk_ps2_mouse_trackpoint_driver)"
osource "/home/gomar/Documents/repos/atlas/zmk-workspace-ble/kb_zmk_ps2_mouse_trackpoint_driver/Kconfig"
config ZEPHYR_KB_ZMK_PS2_MOUSE_TRACKPOINT_DRIVER_MODULE
	bool
	default y
endmenu
menu "zmk-raw-hid (/home/gomar/Documents/repos/atlas/zmk-workspace-ble/zmk-raw-hid)"
osource "/home/gomar/Documents/repos/atlas/zmk-workspace-ble/zmk-raw-hid/Kconfig"
config ZEPHYR_ZMK_RAW_HID_MODULE
	bool
	default y
endmenu
menu "zmk-strata (/home/gomar/Documents/repos/atlas/zmk-workspace-ble/zmk-strata)"
osource "/home/gomar/Documents/repos/atlas/zmk-workspace-ble/zmk-strata/Kconfig"
config ZEPHYR_ZMK_STRATA_MODULE
	bool
	default y
endmenu
config ZEPHYR_HAL_STM32_MODULE
	bool
	default y

config ZEPHYR_HAL_STM32_MODULE_BLOBS
	bool
menu "lvgl (/home/gomar/Documents/repos/atlas/zmk-workspace-ble/modules/lib/gui/lvgl)"
osource "/home/gomar/Documents/repos/atlas/zmk-workspace-ble/modules/lib/gui/lvgl/zephyr/Kconfig"
config ZEPHYR_LVGL_MODULE
	bool
	default y
endmenu
config ZEPHYR_ZMK_STUDIO_MESSAGES_MODULE
	bool
	default y
menu "canopennode (/home/gomar/Documents/repos/atlas/zmk-workspace-ble/modules/lib/canopennode)"
osource "$(ZEPHYR_CANOPENNODE_KCONFIG)"
config ZEPHYR_CANOPENNODE_MODULE
	bool
	default y
endmenu
menu "chre (/home/gomar/Documents/repos/atlas/zmk-workspace-ble/modules/lib/chre)"
osource "/home/gomar/Documents/repos/atlas/zmk-workspace-ble/modules/lib/chre/platform/zephyr/Kconfig"
config ZEPHYR_CHRE_MODULE
	bool
	default y
endmenu
menu "lz4 (/home/gomar/Documents/repos/atlas/zmk-workspace-ble/modules/lib/lz4)"
osource "$(ZEPHYR_LZ4_KCONFIG)"
config ZEPHYR_LZ4_MODULE
	bool
	default y
endmenu
menu "nanopb (/home/gomar/Documents/repos/atlas/zmk-workspace-ble/modules/lib/nanopb)"
osource "$(ZEPHYR_NANOPB_KCONFIG)"
config ZEPHYR_NANOPB_MODULE
	bool
	default y
endmenu
config ZEPHYR_PSA_ARCH_TESTS_MODULE
	bool
	default y
menu "sof (/home/gomar/Documents/repos/atlas/zmk-workspace-ble/modules/audio/sof)"
osource "/home/gomar/Documents/repos/atlas/zmk-workspace-ble/modules/audio/sof/zephyr/Kconfig"
config ZEPHYR_SOF_MODULE
	bool
	default y
endmenu
config ZEPHYR_TF_M_TESTS_MODULE
	bool
	default y
menu "tflite-micro (/home/gomar/Documents/repos/atlas/zmk-workspace-ble/optional/modules/lib/tflite-micro)"
osource "$(ZEPHYR_TFLITE_MICRO_KCONFIG)"
config ZEPHYR_TFLITE_MICRO_MODULE
	bool
	default y
endmenu
menu "thrift (/home/gomar/Documents/repos/atlas/zmk-workspace-ble/optional/modules/lib/thrift)"
osource "$(ZEPHYR_THRIFT_KCONFIG)"
config ZEPHYR_THRIFT_MODULE
	bool
	default y
endmenu
menu "lang-rust (/home/gomar/Documents/repos/atlas/zmk-workspace-ble/modules/lang/rust)"
osource "/home/gomar/Documents/repos/atlas/zmk-workspace-ble/modules/lang/rust/Kconfig"
config ZEPHYR_LANG_RUST_MODULE
	bool
	default y
endmenu
menu "zscilib (/home/gomar/Documents/repos/atlas/zmk-workspace-ble/modules/lib/zscilib)"
osource "/home/gomar/Documents/repos/atlas/zmk-workspace-ble/modules/lib/zscilib/Kconfig.zscilib"
config ZEPHYR_ZSCILIB_MODULE
	bool
	default y
endmenu
menu "acpica (/home/gomar/Documents/repos/atlas/zmk-workspace-ble/modules/lib/acpica)"
osource "$(ZEPHYR_ACPICA_KCONFIG)"
config ZEPHYR_ACPICA_MODULE
	bool
	default y
endmenu
menu "cmsis (/home/gomar/Documents/repos/atlas/zmk-workspace-ble/modules/hal/cmsis)"
osource "$(ZEPHYR_CMSIS_KCONFIG)"
config ZEPHYR_CMSIS_MODULE
	bool
	default y
endmenu
menu "cmsis-dsp (/home/gomar/Documents/repos/atlas/zmk-workspace-ble/modules/lib/cmsis-dsp)"
osource "$(ZEPHYR_CMSIS_DSP_KCONFIG)"
config ZEPHYR_CMSIS_DSP_MODULE
	bool
	default y
endmenu
menu "cmsis-nn (/home/gomar/Documents/repos/atlas/zmk-workspace-ble/modules/lib/cmsis-nn)"
osource "$(ZEPHYR_CMSIS_NN_KCONFIG)"
config ZEPHYR_CMSIS_NN_MODULE
	bool
	default y
endmenu
menu "fatfs (/home/gomar/Documents/repos/atlas/zmk-workspace-ble/modules/fs/fatfs)"
osource "$(ZEPHYR_FATFS_KCONFIG)"
config ZEPHYR_FATFS_MODULE
	bool
	default y
endmenu
config ZEPHYR_ADI_MODULE
	bool
	default y
menu "hal_ambiq (/home/gomar/Documents/repos/atlas/zmk-workspace-ble/modules/hal/ambiq)"
osource "$(ZEPHYR_HAL_AMBIQ_KCONFIG)"
config ZEPHYR_HAL_AMBIQ_MODULE
	bool
	default y
endmenu
config ZEPHYR_ATMEL_MODULE
	bool
	default y
menu "hal_espressif (/home/gomar/Documents/repos/atlas/zmk-workspace-ble/modules/hal/espressif)"
osource "/home/gomar/Documents/repos/atlas/zmk-workspace-ble/modules/hal/espressif/zephyr/Kconfig"
config ZEPHYR_HAL_ESPRESSIF_MODULE
	bool
	default y

config ZEPHYR_HAL_ESPRESSIF_MODULE_BLOBS
	bool
endmenu
menu "hal_ethos_u (/home/gomar/Documents/repos/atlas/zmk-workspace-ble/modules/hal/ethos_u)"
osource "$(ZEPHYR_HAL_ETHOS_U_KCONFIG)"
config ZEPHYR_HAL_ETHOS_U_MODULE
	bool
	default y
endmenu
menu "hal_gigadevice (/home/gomar/Documents/repos/atlas/zmk-workspace-ble/modules/hal/gigadevice)"
osource "$(ZEPHYR_HAL_GIGADEVICE_KCONFIG)"
config ZEPHYR_HAL_GIGADEVICE_MODULE
	bool
	default y
endmenu
menu "hal_intel (/home/gomar/Documents/repos/atlas/zmk-workspace-ble/modules/hal/intel)"
osource "/home/gomar/Documents/repos/atlas/zmk-workspace-ble/modules/hal/intel/zephyr/Kconfig"
config ZEPHYR_HAL_INTEL_MODULE
	bool
	default y
endmenu
menu "hal_nordic (/home/gomar/Documents/repos/atlas/zmk-workspace-ble/modules/hal/nordic)"
osource "$(ZEPHYR_HAL_NORDIC_KCONFIG)"
config ZEPHYR_HAL_NORDIC_MODULE
	bool
	default y

config ZEPHYR_HAL_NORDIC_MODULE_BLOBS
	bool
endmenu
config ZEPHYR_NUVOTON_MODULE
	bool
	default y
config ZEPHYR_QUICKLOGIC_MODULE
	bool
	default y
config ZEPHYR_HAL_RENESAS_MODULE
	bool
	default y

config ZEPHYR_HAL_RENESAS_MODULE_BLOBS
	bool
menu "hal_rpi_pico (/home/gomar/Documents/repos/atlas/zmk-workspace-ble/modules/hal/rpi_pico)"
osource "$(ZEPHYR_HAL_RPI_PICO_KCONFIG)"
config ZEPHYR_HAL_RPI_PICO_MODULE
	bool
	default y
endmenu
menu "hal_silabs (/home/gomar/Documents/repos/atlas/zmk-workspace-ble/modules/hal/silabs)"
osource "$(ZEPHYR_HAL_SILABS_KCONFIG)"
config ZEPHYR_HAL_SILABS_MODULE
	bool
	default y

config ZEPHYR_HAL_SILABS_MODULE_BLOBS
	bool
endmenu
menu "hal_tdk (/home/gomar/Documents/repos/atlas/zmk-workspace-ble/modules/hal/tdk)"
osource "$(ZEPHYR_HAL_TDK_KCONFIG)"
config ZEPHYR_HAL_TDK_MODULE
	bool
	default y
endmenu
menu "hal_telink (/home/gomar/Documents/repos/atlas/zmk-workspace-ble/modules/hal/telink)"
osource "/home/gomar/Documents/repos/atlas/zmk-workspace-ble/modules/hal/telink/Kconfig"
config ZEPHYR_HAL_TELINK_MODULE
	bool
	default y
endmenu
menu "hal_wch (/home/gomar/Documents/repos/atlas/zmk-workspace-ble/modules/hal/wch)"
osource "$(ZEPHYR_HAL_WCH_KCONFIG)"
config ZEPHYR_HAL_WCH_MODULE
	bool
	default y
endmenu
config ZEPHYR_HAL_WURTHELEKTRONIK_MODULE
	bool
	default y
menu "hostap (/home/gomar/Documents/repos/atlas/zmk-workspace-ble/modules/lib/hostap)"
osource "$(ZEPHYR_HOSTAP_KCONFIG)"
config ZEPHYR_HOSTAP_MODULE
	bool
	default y
endmenu
menu "liblc3 (/home/gomar/Documents/repos/atlas/zmk-workspace-ble/modules/lib/liblc3)"
osource "$(ZEPHYR_LIBLC3_KCONFIG)"
config ZEPHYR_LIBLC3_MODULE
	bool
	default y
endmenu
config ZEPHYR_LIBMCTP_MODULE
	bool
	default y
config ZEPHYR_LIBMETAL_MODULE
	bool
	default y
menu "littlefs (/home/gomar/Documents/repos/atlas/zmk-workspace-ble/modules/fs/littlefs)"
osource "$(ZEPHYR_LITTLEFS_KCONFIG)"
config ZEPHYR_LITTLEFS_MODULE
	bool
	default y
endmenu
menu "mbedtls (/home/gomar/Documents/repos/atlas/zmk-workspace-ble/modules/crypto/mbedtls)"
osource "$(ZEPHYR_MBEDTLS_KCONFIG)"
config ZEPHYR_MBEDTLS_MODULE
	bool
	default y
endmenu
config ZEPHYR_MIPI_SYS_T_MODULE
	bool
	default y
menu "nrf_wifi (/home/gomar/Documents/repos/atlas/zmk-workspace-ble/modules/lib/nrf_wifi)"
osource "$(ZEPHYR_NRF_WIFI_KCONFIG)"
config ZEPHYR_NRF_WIFI_MODULE
	bool
	default y

config ZEPHYR_NRF_WIFI_MODULE_BLOBS
	bool
endmenu
config ZEPHYR_OPEN_AMP_MODULE
	bool
	default y
menu "percepio (/home/gomar/Documents/repos/atlas/zmk-workspace-ble/modules/debug/percepio)"
osource "/home/gomar/Documents/repos/atlas/zmk-workspace-ble/modules/debug/percepio/zephyr/Kconfig"
config ZEPHYR_PERCEPIO_MODULE
	bool
	default y
endmenu
menu "picolibc (/home/gomar/Documents/repos/atlas/zmk-workspace-ble/modules/lib/picolibc)"
osource "/home/gomar/Documents/repos/atlas/zmk-workspace-ble/modules/lib/picolibc/zephyr/Kconfig"
config ZEPHYR_PICOLIBC_MODULE
	bool
	default y
endmenu
menu "segger (/home/gomar/Documents/repos/atlas/zmk-workspace-ble/modules/debug/segger)"
osource "$(ZEPHYR_SEGGER_KCONFIG)"
config ZEPHYR_SEGGER_MODULE
	bool
	default y
endmenu
config ZEPHYR_TINYCRYPT_MODULE
	bool
	default y
menu "trusted-firmware-a (/home/gomar/Documents/repos/atlas/zmk-workspace-ble/modules/tee/tf-a/trusted-firmware-a)"
osource "$(ZEPHYR_TRUSTED_FIRMWARE_A_KCONFIG)"
config ZEPHYR_TRUSTED_FIRMWARE_A_MODULE
	bool
	default y
endmenu
menu "uoscore-uedhoc (/home/gomar/Documents/repos/atlas/zmk-workspace-ble/modules/lib/uoscore-uedhoc)"
osource "$(ZEPHYR_UOSCORE_UEDHOC_KCONFIG)"
config ZEPHYR_UOSCORE_UEDHOC_MODULE
	bool
	default y
endmenu
menu "zcbor (/home/gomar/Documents/repos/atlas/zmk-workspace-ble/modules/lib/zcbor)"
osource "$(ZEPHYR_ZCBOR_KCONFIG)"
config ZEPHYR_ZCBOR_MODULE
	bool
	default y
endmenu
menu "module (/home/gomar/Documents/repos/atlas/zmk-workspace-ble/zmk/app/module)"
osource "/home/gomar/Documents/repos/atlas/zmk-workspace-ble/zmk/app/module/Kconfig"
config ZEPHYR_MODULE_MODULE
	bool
	default y
endmenu
config ZEPHYR_KEYMAP_MODULE_MODULE
	bool
	default y
config ZEPHYR_NRF_HW_MODELS_MODULE
	bool
	default y
```

## zmk-workspace-ble/build/right/Kconfig/Kconfig.shield.defconfig
```kconfig
osource "/home/gomar/Documents/repos/atlas/zmk-workspace-ble/zmk-raw-hid/boards/shields/*/Kconfig.defconfig"
osource "/home/gomar/Documents/repos/atlas/zmk-workspace-ble/zmk/app/module/boards/shields/*/Kconfig.defconfig"
osource "/home/gomar/Documents/repos/atlas/zmk-workspace-ble/zmk/app/boards/shields/*/Kconfig.defconfig"
osource "/home/gomar/Documents/repos/atlas/zmk-workspace-ble/config/boards/shields/*/Kconfig.defconfig"
```

## zmk-workspace-ble/build/right/Kconfig/boards/Kconfig
```kconfig
# Load Zephyr board Kconfig descriptions.
osource "/home/gomar/Documents/repos/atlas/zmk-workspace-ble/zephyr/boards/seeed/xiao_ble/Kconfig"
osource "/home/gomar/Documents/repos/atlas/zmk-workspace-ble/zmk/app/boards/seeed/xiao_ble/Kconfig"
```

## zmk-workspace-ble/build/right/Kconfig/boards/Kconfig.defconfig
```kconfig
# Load Zephyr board defconfig descriptions.
osource "/home/gomar/Documents/repos/atlas/zmk-workspace-ble/zephyr/boards/seeed/xiao_ble/Kconfig.defconfig"
osource "/home/gomar/Documents/repos/atlas/zmk-workspace-ble/zmk/app/boards/seeed/xiao_ble/Kconfig.defconfig"
```

## zmk-workspace-ble/build/right/Kconfig/boards/Kconfig.xiao_ble
```kconfig
# Load board Kconfig descriptions.
osource "/home/gomar/Documents/repos/atlas/zmk-workspace-ble/zephyr/boards/seeed/xiao_ble/Kconfig.xiao_ble"
osource "/home/gomar/Documents/repos/atlas/zmk-workspace-ble/zmk/app/boards/seeed/xiao_ble/Kconfig.xiao_ble"
```
