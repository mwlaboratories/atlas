## zmk-workspace-ble/build/left/Kconfig/soc/Kconfig.defconfig
```kconfig
# Load Zephyr SoC defconfig descriptions.
osource "/home/gomar/Documents/repos/atlas/zmk-workspace-ble/zephyr/soc/xlnx/zynqmp/Kconfig.defconfig"
osource "/home/gomar/Documents/repos/atlas/zmk-workspace-ble/zephyr/soc/xlnx/zynq7000/Kconfig.defconfig"
osource "/home/gomar/Documents/repos/atlas/zmk-workspace-ble/zephyr/soc/xen/Kconfig.defconfig"
osource "/home/gomar/Documents/repos/atlas/zmk-workspace-ble/zephyr/soc/wch/ch32v/Kconfig.defconfig"
osource "/home/gomar/Documents/repos/atlas/zmk-workspace-ble/zephyr/soc/ti/simplelink/Kconfig.defconfig"
osource "/home/gomar/Documents/repos/atlas/zmk-workspace-ble/zephyr/soc/ti/lm3s6965/Kconfig.defconfig"
osource "/home/gomar/Documents/repos/atlas/zmk-workspace-ble/zephyr/soc/ti/k3/Kconfig.defconfig"
osource "/home/gomar/Documents/repos/atlas/zmk-workspace-ble/zephyr/soc/telink/tlsr/Kconfig.defconfig"
osource "/home/gomar/Documents/repos/atlas/zmk-workspace-ble/zephyr/soc/starfive/jh71xx/Kconfig.defconfig"
osource "/home/gomar/Documents/repos/atlas/zmk-workspace-ble/zephyr/soc/st/stm32/Kconfig.defconfig"
osource "/home/gomar/Documents/repos/atlas/zmk-workspace-ble/zephyr/soc/snps/qemu_arc/Kconfig.defconfig"
osource "/home/gomar/Documents/repos/atlas/zmk-workspace-ble/zephyr/soc/snps/nsim/arc_v/Kconfig.defconfig"
osource "/home/gomar/Documents/repos/atlas/zmk-workspace-ble/zephyr/soc/snps/nsim/arc_classic/Kconfig.defconfig"
osource "/home/gomar/Documents/repos/atlas/zmk-workspace-ble/zephyr/soc/snps/hsdk4xd/Kconfig.defconfig"
osource "/home/gomar/Documents/repos/atlas/zmk-workspace-ble/zephyr/soc/snps/hsdk/Kconfig.defconfig"
osource "/home/gomar/Documents/repos/atlas/zmk-workspace-ble/zephyr/soc/snps/emsk/Kconfig.defconfig"
osource "/home/gomar/Documents/repos/atlas/zmk-workspace-ble/zephyr/soc/snps/emsdp/Kconfig.defconfig"
osource "/home/gomar/Documents/repos/atlas/zmk-workspace-ble/zephyr/soc/snps/arc_iot/Kconfig.defconfig"
osource "/home/gomar/Documents/repos/atlas/zmk-workspace-ble/zephyr/soc/silabs/Kconfig.defconfig"
osource "/home/gomar/Documents/repos/atlas/zmk-workspace-ble/zephyr/soc/sifive/sifive_freedom/Kconfig.defconfig"
osource "/home/gomar/Documents/repos/atlas/zmk-workspace-ble/zephyr/soc/sensry/Kconfig.defconfig"
osource "/home/gomar/Documents/repos/atlas/zmk-workspace-ble/zephyr/soc/rockchip/Kconfig.defconfig"
osource "/home/gomar/Documents/repos/atlas/zmk-workspace-ble/zephyr/soc/renode/riscv_virtual/Kconfig.defconfig"
osource "/home/gomar/Documents/repos/atlas/zmk-workspace-ble/zephyr/soc/renode/cortex_r8_virtual/Kconfig.defconfig"
osource "/home/gomar/Documents/repos/atlas/zmk-workspace-ble/zephyr/soc/renesas/smartbond/Kconfig.defconfig"
osource "/home/gomar/Documents/repos/atlas/zmk-workspace-ble/zephyr/soc/renesas/rzt2m/Kconfig.defconfig"
osource "/home/gomar/Documents/repos/atlas/zmk-workspace-ble/zephyr/soc/renesas/rz/Kconfig.defconfig"
osource "/home/gomar/Documents/repos/atlas/zmk-workspace-ble/zephyr/soc/renesas/rcar/Kconfig.defconfig"
osource "/home/gomar/Documents/repos/atlas/zmk-workspace-ble/zephyr/soc/renesas/ra/Kconfig.defconfig"
osource "/home/gomar/Documents/repos/atlas/zmk-workspace-ble/zephyr/soc/realtek/ec/Kconfig.defconfig"
osource "/home/gomar/Documents/repos/atlas/zmk-workspace-ble/zephyr/soc/raspberrypi/rpi_pico/Kconfig.defconfig"
osource "/home/gomar/Documents/repos/atlas/zmk-workspace-ble/zephyr/soc/quicklogic/eos_s3/Kconfig.defconfig"
osource "/home/gomar/Documents/repos/atlas/zmk-workspace-ble/zephyr/soc/qemu/virt_riscv/Kconfig.defconfig"
osource "/home/gomar/Documents/repos/atlas/zmk-workspace-ble/zephyr/soc/qemu/malta/Kconfig.defconfig"
osource "/home/gomar/Documents/repos/atlas/zmk-workspace-ble/zephyr/soc/openisa/rv32m1/Kconfig.defconfig"
osource "/home/gomar/Documents/repos/atlas/zmk-workspace-ble/zephyr/soc/nxp/s32/Kconfig.defconfig"
osource "/home/gomar/Documents/repos/atlas/zmk-workspace-ble/zephyr/soc/nxp/rw/Kconfig.defconfig"
osource "/home/gomar/Documents/repos/atlas/zmk-workspace-ble/zephyr/soc/nxp/mcx/Kconfig.defconfig"
osource "/home/gomar/Documents/repos/atlas/zmk-workspace-ble/zephyr/soc/nxp/lpc/Kconfig.defconfig"
osource "/home/gomar/Documents/repos/atlas/zmk-workspace-ble/zephyr/soc/nxp/layerscape/Kconfig.defconfig"
osource "/home/gomar/Documents/repos/atlas/zmk-workspace-ble/zephyr/soc/nxp/kinetis/Kconfig.defconfig"
osource "/home/gomar/Documents/repos/atlas/zmk-workspace-ble/zephyr/soc/nxp/imxrt/Kconfig.defconfig"
osource "/home/gomar/Documents/repos/atlas/zmk-workspace-ble/zephyr/soc/nxp/imx/Kconfig.defconfig"
osource "/home/gomar/Documents/repos/atlas/zmk-workspace-ble/zephyr/soc/nuvoton/numicro/Kconfig.defconfig"
osource "/home/gomar/Documents/repos/atlas/zmk-workspace-ble/zephyr/soc/nuvoton/numaker/Kconfig.defconfig"
osource "/home/gomar/Documents/repos/atlas/zmk-workspace-ble/zephyr/soc/nuvoton/npcx/Kconfig.defconfig"
osource "/home/gomar/Documents/repos/atlas/zmk-workspace-ble/zephyr/soc/nuvoton/npcm/Kconfig.defconfig"
osource "/home/gomar/Documents/repos/atlas/zmk-workspace-ble/zephyr/soc/nordic/Kconfig.defconfig"
osource "/home/gomar/Documents/repos/atlas/zmk-workspace-ble/zephyr/soc/neorv32/Kconfig.defconfig"
osource "/home/gomar/Documents/repos/atlas/zmk-workspace-ble/zephyr/soc/native/inf_clock/Kconfig.defconfig"
osource "/home/gomar/Documents/repos/atlas/zmk-workspace-ble/zephyr/soc/microchip/miv/Kconfig.defconfig"
osource "/home/gomar/Documents/repos/atlas/zmk-workspace-ble/zephyr/soc/microchip/mec/Kconfig.defconfig"
osource "/home/gomar/Documents/repos/atlas/zmk-workspace-ble/zephyr/soc/mediatek/mt8xxx/Kconfig.defconfig"
osource "/home/gomar/Documents/repos/atlas/zmk-workspace-ble/zephyr/soc/lowrisc/opentitan/Kconfig.defconfig"
osource "/home/gomar/Documents/repos/atlas/zmk-workspace-ble/zephyr/soc/litex/litex_vexriscv/Kconfig.defconfig"
osource "/home/gomar/Documents/repos/atlas/zmk-workspace-ble/zephyr/soc/ite/ec/Kconfig.defconfig"
osource "/home/gomar/Documents/repos/atlas/zmk-workspace-ble/zephyr/soc/intel/raptor_lake/Kconfig.defconfig"
osource "/home/gomar/Documents/repos/atlas/zmk-workspace-ble/zephyr/soc/intel/lakemont/Kconfig.defconfig"
osource "/home/gomar/Documents/repos/atlas/zmk-workspace-ble/zephyr/soc/intel/intel_socfpga_std/Kconfig.defconfig"
osource "/home/gomar/Documents/repos/atlas/zmk-workspace-ble/zephyr/soc/intel/intel_socfpga/Kconfig.defconfig"
osource "/home/gomar/Documents/repos/atlas/zmk-workspace-ble/zephyr/soc/intel/intel_niosv/Kconfig.defconfig"
osource "/home/gomar/Documents/repos/atlas/zmk-workspace-ble/zephyr/soc/intel/intel_ish/Kconfig.defconfig"
osource "/home/gomar/Documents/repos/atlas/zmk-workspace-ble/zephyr/soc/intel/intel_adsp/Kconfig.defconfig"
osource "/home/gomar/Documents/repos/atlas/zmk-workspace-ble/zephyr/soc/intel/elkhart_lake/Kconfig.defconfig"
osource "/home/gomar/Documents/repos/atlas/zmk-workspace-ble/zephyr/soc/intel/atom/Kconfig.defconfig"
osource "/home/gomar/Documents/repos/atlas/zmk-workspace-ble/zephyr/soc/intel/apollo_lake/Kconfig.defconfig"
osource "/home/gomar/Documents/repos/atlas/zmk-workspace-ble/zephyr/soc/intel/alder_lake/Kconfig.defconfig"
osource "/home/gomar/Documents/repos/atlas/zmk-workspace-ble/zephyr/soc/infineon/cat3/Kconfig.defconfig"
osource "/home/gomar/Documents/repos/atlas/zmk-workspace-ble/zephyr/soc/infineon/cat1b/Kconfig.defconfig"
osource "/home/gomar/Documents/repos/atlas/zmk-workspace-ble/zephyr/soc/infineon/cat1a/Kconfig.defconfig"
osource "/home/gomar/Documents/repos/atlas/zmk-workspace-ble/zephyr/soc/gd/gd32/Kconfig.defconfig"
osource "/home/gomar/Documents/repos/atlas/zmk-workspace-ble/zephyr/soc/gaisler/leon3/Kconfig.defconfig"
osource "/home/gomar/Documents/repos/atlas/zmk-workspace-ble/zephyr/soc/gaisler/gr716a/Kconfig.defconfig"
osource "/home/gomar/Documents/repos/atlas/zmk-workspace-ble/zephyr/soc/espressif/Kconfig.defconfig"
osource "/home/gomar/Documents/repos/atlas/zmk-workspace-ble/zephyr/soc/ene/kb1200/Kconfig.defconfig"
osource "/home/gomar/Documents/repos/atlas/zmk-workspace-ble/zephyr/soc/efinix/sapphire/Kconfig.defconfig"
osource "/home/gomar/Documents/repos/atlas/zmk-workspace-ble/zephyr/soc/cdns/xtensa_sample_controller/Kconfig.defconfig"
osource "/home/gomar/Documents/repos/atlas/zmk-workspace-ble/zephyr/soc/cdns/sample_controller32/Kconfig.defconfig"
osource "/home/gomar/Documents/repos/atlas/zmk-workspace-ble/zephyr/soc/cdns/dc233c/Kconfig.defconfig"
osource "/home/gomar/Documents/repos/atlas/zmk-workspace-ble/zephyr/soc/brcm/bcmvk/Kconfig.defconfig"
osource "/home/gomar/Documents/repos/atlas/zmk-workspace-ble/zephyr/soc/brcm/bcm2712/Kconfig.defconfig"
osource "/home/gomar/Documents/repos/atlas/zmk-workspace-ble/zephyr/soc/brcm/bcm2711/Kconfig.defconfig"
osource "/home/gomar/Documents/repos/atlas/zmk-workspace-ble/zephyr/soc/atmel/sam0/Kconfig.defconfig"
osource "/home/gomar/Documents/repos/atlas/zmk-workspace-ble/zephyr/soc/atmel/sam/Kconfig.defconfig"
osource "/home/gomar/Documents/repos/atlas/zmk-workspace-ble/zephyr/soc/aspeed/Kconfig.defconfig"
osource "/home/gomar/Documents/repos/atlas/zmk-workspace-ble/zephyr/soc/arm/Kconfig.defconfig"
osource "/home/gomar/Documents/repos/atlas/zmk-workspace-ble/zephyr/soc/arm/beetle/Kconfig.defconfig"
osource "/home/gomar/Documents/repos/atlas/zmk-workspace-ble/zephyr/soc/antmicro/myra/Kconfig.defconfig"
osource "/home/gomar/Documents/repos/atlas/zmk-workspace-ble/zephyr/soc/andestech/Kconfig.defconfig"
osource "/home/gomar/Documents/repos/atlas/zmk-workspace-ble/zephyr/soc/amd/acp_6_0/Kconfig.defconfig"
osource "/home/gomar/Documents/repos/atlas/zmk-workspace-ble/zephyr/soc/ambiq/Kconfig.defconfig"
osource "/home/gomar/Documents/repos/atlas/zmk-workspace-ble/zephyr/soc/altr/zephyr_nios2f/Kconfig.defconfig"
osource "/home/gomar/Documents/repos/atlas/zmk-workspace-ble/zephyr/soc/altr/qemu_nios2/Kconfig.defconfig"
osource "/home/gomar/Documents/repos/atlas/zmk-workspace-ble/zephyr/soc/adi/max32/Kconfig.defconfig"
```
