## firmware/ble/config/boards/shields/old_prototype/Kconfig.shield
```kconfig
config SHIELD_OLD_PROTOTYPE_LEFT
    def_bool $(shields_list_contains,old_prototype_left)

config SHIELD_OLD_PROTOTYPE_RIGHT
    def_bool $(shields_list_contains,old_prototype_right)

config SHIELD_OLD_PROTOTYPE_DONGLE
    def_bool $(shields_list_contains,old_prototype_dongle)

config SHIELD_OLD_PROTOTYPE_TRACKBALL
    def_bool $(shields_list_contains,old_prototype_trackball)
```

## zmk-workspace-ble/build/left/Kconfig/Kconfig.shield
```kconfig
osource "/home/gomar/Documents/repos/atlas/zmk-workspace-ble/zmk-raw-hid/boards/shields/*/Kconfig.shield"
osource "/home/gomar/Documents/repos/atlas/zmk-workspace-ble/zmk/app/module/boards/shields/*/Kconfig.shield"
osource "/home/gomar/Documents/repos/atlas/zmk-workspace-ble/zmk/app/boards/shields/*/Kconfig.shield"
osource "/home/gomar/Documents/repos/atlas/zmk-workspace-ble/config/boards/shields/*/Kconfig.shield"
```

## zmk-workspace-ble/build/left/Kconfig/Kconfig.sysbuild.modules
```kconfig
config ZEPHYR_KB_ZMK_PS2_MOUSE_TRACKPOINT_DRIVER_MODULE
   bool
   default y
config ZEPHYR_ZMK_RAW_HID_MODULE
   bool
   default y
config ZEPHYR_ZMK_STRATA_MODULE
   bool
   default y
config ZEPHYR_HAL_STM32_MODULE
   bool
   default y
config ZEPHYR_LVGL_MODULE
   bool
   default y
config ZEPHYR_ZMK_STUDIO_MESSAGES_MODULE
   bool
   default y
config ZEPHYR_CANOPENNODE_MODULE
   bool
   default y
config ZEPHYR_CHRE_MODULE
   bool
   default y
config ZEPHYR_LZ4_MODULE
   bool
   default y
config ZEPHYR_NANOPB_MODULE
   bool
   default y
config ZEPHYR_PSA_ARCH_TESTS_MODULE
   bool
   default y
config ZEPHYR_SOF_MODULE
   bool
   default y
config ZEPHYR_TF_M_TESTS_MODULE
   bool
   default y
config ZEPHYR_TFLITE_MICRO_MODULE
   bool
   default y
config ZEPHYR_THRIFT_MODULE
   bool
   default y
config ZEPHYR_LANG_RUST_MODULE
   bool
   default y
config ZEPHYR_ZSCILIB_MODULE
   bool
   default y
config ZEPHYR_ACPICA_MODULE
   bool
   default y
config ZEPHYR_CMSIS_MODULE
   bool
   default y
config ZEPHYR_CMSIS_DSP_MODULE
   bool
   default y
config ZEPHYR_CMSIS_NN_MODULE
   bool
   default y
config ZEPHYR_FATFS_MODULE
   bool
   default y
config ZEPHYR_ADI_MODULE
   bool
   default y
config ZEPHYR_HAL_AMBIQ_MODULE
   bool
   default y
config ZEPHYR_ATMEL_MODULE
   bool
   default y
config ZEPHYR_HAL_ESPRESSIF_MODULE
   bool
   default y
config ZEPHYR_HAL_ETHOS_U_MODULE
   bool
   default y
config ZEPHYR_HAL_GIGADEVICE_MODULE
   bool
   default y
config ZEPHYR_HAL_INTEL_MODULE
   bool
   default y
config ZEPHYR_HAL_NORDIC_MODULE
   bool
   default y
config ZEPHYR_NUVOTON_MODULE
   bool
   default y
config ZEPHYR_QUICKLOGIC_MODULE
   bool
   default y
config ZEPHYR_HAL_RENESAS_MODULE
   bool
   default y
config ZEPHYR_HAL_RPI_PICO_MODULE
   bool
   default y
config ZEPHYR_HAL_SILABS_MODULE
   bool
   default y
config ZEPHYR_HAL_TDK_MODULE
   bool
   default y
config ZEPHYR_HAL_TELINK_MODULE
   bool
   default y
config ZEPHYR_HAL_WCH_MODULE
   bool
   default y
config ZEPHYR_HAL_WURTHELEKTRONIK_MODULE
   bool
   default y
config ZEPHYR_HOSTAP_MODULE
   bool
   default y
config ZEPHYR_LIBLC3_MODULE
   bool
   default y
config ZEPHYR_LIBMCTP_MODULE
   bool
   default y
config ZEPHYR_LIBMETAL_MODULE
   bool
   default y
config ZEPHYR_LITTLEFS_MODULE
   bool
   default y
config ZEPHYR_MBEDTLS_MODULE
   bool
   default y
config ZEPHYR_MIPI_SYS_T_MODULE
   bool
   default y
config ZEPHYR_NRF_WIFI_MODULE
   bool
   default y
config ZEPHYR_OPEN_AMP_MODULE
   bool
   default y
config ZEPHYR_PERCEPIO_MODULE
   bool
   default y
config ZEPHYR_PICOLIBC_MODULE
   bool
   default y
config ZEPHYR_SEGGER_MODULE
   bool
   default y
config ZEPHYR_TINYCRYPT_MODULE
   bool
   default y
config ZEPHYR_TRUSTED_FIRMWARE_A_MODULE
   bool
   default y
config ZEPHYR_UOSCORE_UEDHOC_MODULE
   bool
   default y
config ZEPHYR_ZCBOR_MODULE
   bool
   default y
config ZEPHYR_MODULE_MODULE
   bool
   default y
config ZEPHYR_KEYMAP_MODULE_MODULE
   bool
   default y
config ZEPHYR_NRF_HW_MODELS_MODULE
   bool
   default y
```

## zmk-workspace-ble/build/left/Kconfig/arch/Kconfig
```kconfig
# Load Zephyr Arch Kconfig descriptions.
osource "/home/gomar/Documents/repos/atlas/zmk-workspace-ble/zephyr/arch/x86/Kconfig"
osource "/home/gomar/Documents/repos/atlas/zmk-workspace-ble/zephyr/arch/xtensa/Kconfig"
osource "/home/gomar/Documents/repos/atlas/zmk-workspace-ble/zephyr/arch/sparc/Kconfig"
osource "/home/gomar/Documents/repos/atlas/zmk-workspace-ble/zephyr/arch/riscv/Kconfig"
osource "/home/gomar/Documents/repos/atlas/zmk-workspace-ble/zephyr/arch/posix/Kconfig"
osource "/home/gomar/Documents/repos/atlas/zmk-workspace-ble/zephyr/arch/nios2/Kconfig"
osource "/home/gomar/Documents/repos/atlas/zmk-workspace-ble/zephyr/arch/mips/Kconfig"
osource "/home/gomar/Documents/repos/atlas/zmk-workspace-ble/zephyr/arch/arm64/Kconfig"
osource "/home/gomar/Documents/repos/atlas/zmk-workspace-ble/zephyr/arch/arm/Kconfig"
osource "/home/gomar/Documents/repos/atlas/zmk-workspace-ble/zephyr/arch/arc/Kconfig"
```

## zmk-workspace-ble/build/left/Kconfig/boards/Kconfig.sysbuild
```kconfig
# Load Sysbuild board Kconfig descriptions.
osource "/home/gomar/Documents/repos/atlas/zmk-workspace-ble/zephyr/boards/seeed/xiao_ble/Kconfig.sysbuild"
osource "/home/gomar/Documents/repos/atlas/zmk-workspace-ble/zmk/app/boards/seeed/xiao_ble/Kconfig.sysbuild"
```

## zmk-workspace-ble/build/left/Kconfig/soc/Kconfig
```kconfig
# Load Zephyr SoC Kconfig descriptions.
osource "/home/gomar/Documents/repos/atlas/zmk-workspace-ble/zephyr/soc/xlnx/zynqmp/Kconfig"
osource "/home/gomar/Documents/repos/atlas/zmk-workspace-ble/zephyr/soc/xlnx/zynq7000/Kconfig"
osource "/home/gomar/Documents/repos/atlas/zmk-workspace-ble/zephyr/soc/xen/Kconfig"
osource "/home/gomar/Documents/repos/atlas/zmk-workspace-ble/zephyr/soc/wch/ch32v/Kconfig"
osource "/home/gomar/Documents/repos/atlas/zmk-workspace-ble/zephyr/soc/ti/simplelink/Kconfig"
osource "/home/gomar/Documents/repos/atlas/zmk-workspace-ble/zephyr/soc/ti/lm3s6965/Kconfig"
osource "/home/gomar/Documents/repos/atlas/zmk-workspace-ble/zephyr/soc/ti/k3/Kconfig"
osource "/home/gomar/Documents/repos/atlas/zmk-workspace-ble/zephyr/soc/telink/tlsr/Kconfig"
osource "/home/gomar/Documents/repos/atlas/zmk-workspace-ble/zephyr/soc/starfive/jh71xx/Kconfig"
osource "/home/gomar/Documents/repos/atlas/zmk-workspace-ble/zephyr/soc/st/stm32/Kconfig"
osource "/home/gomar/Documents/repos/atlas/zmk-workspace-ble/zephyr/soc/snps/qemu_arc/Kconfig"
osource "/home/gomar/Documents/repos/atlas/zmk-workspace-ble/zephyr/soc/snps/nsim/arc_v/Kconfig"
osource "/home/gomar/Documents/repos/atlas/zmk-workspace-ble/zephyr/soc/snps/nsim/arc_classic/Kconfig"
osource "/home/gomar/Documents/repos/atlas/zmk-workspace-ble/zephyr/soc/snps/hsdk4xd/Kconfig"
osource "/home/gomar/Documents/repos/atlas/zmk-workspace-ble/zephyr/soc/snps/hsdk/Kconfig"
osource "/home/gomar/Documents/repos/atlas/zmk-workspace-ble/zephyr/soc/snps/emsk/Kconfig"
osource "/home/gomar/Documents/repos/atlas/zmk-workspace-ble/zephyr/soc/snps/emsdp/Kconfig"
osource "/home/gomar/Documents/repos/atlas/zmk-workspace-ble/zephyr/soc/snps/arc_iot/Kconfig"
osource "/home/gomar/Documents/repos/atlas/zmk-workspace-ble/zephyr/soc/silabs/Kconfig"
osource "/home/gomar/Documents/repos/atlas/zmk-workspace-ble/zephyr/soc/sifive/sifive_freedom/Kconfig"
osource "/home/gomar/Documents/repos/atlas/zmk-workspace-ble/zephyr/soc/sensry/Kconfig"
osource "/home/gomar/Documents/repos/atlas/zmk-workspace-ble/zephyr/soc/rockchip/Kconfig"
osource "/home/gomar/Documents/repos/atlas/zmk-workspace-ble/zephyr/soc/renode/riscv_virtual/Kconfig"
osource "/home/gomar/Documents/repos/atlas/zmk-workspace-ble/zephyr/soc/renode/cortex_r8_virtual/Kconfig"
osource "/home/gomar/Documents/repos/atlas/zmk-workspace-ble/zephyr/soc/renesas/smartbond/Kconfig"
osource "/home/gomar/Documents/repos/atlas/zmk-workspace-ble/zephyr/soc/renesas/rzt2m/Kconfig"
osource "/home/gomar/Documents/repos/atlas/zmk-workspace-ble/zephyr/soc/renesas/rz/Kconfig"
osource "/home/gomar/Documents/repos/atlas/zmk-workspace-ble/zephyr/soc/renesas/rcar/Kconfig"
osource "/home/gomar/Documents/repos/atlas/zmk-workspace-ble/zephyr/soc/renesas/ra/Kconfig"
osource "/home/gomar/Documents/repos/atlas/zmk-workspace-ble/zephyr/soc/realtek/ec/Kconfig"
osource "/home/gomar/Documents/repos/atlas/zmk-workspace-ble/zephyr/soc/raspberrypi/rpi_pico/Kconfig"
osource "/home/gomar/Documents/repos/atlas/zmk-workspace-ble/zephyr/soc/quicklogic/eos_s3/Kconfig"
osource "/home/gomar/Documents/repos/atlas/zmk-workspace-ble/zephyr/soc/qemu/virt_riscv/Kconfig"
osource "/home/gomar/Documents/repos/atlas/zmk-workspace-ble/zephyr/soc/qemu/malta/Kconfig"
osource "/home/gomar/Documents/repos/atlas/zmk-workspace-ble/zephyr/soc/openisa/rv32m1/Kconfig"
osource "/home/gomar/Documents/repos/atlas/zmk-workspace-ble/zephyr/soc/nxp/s32/Kconfig"
osource "/home/gomar/Documents/repos/atlas/zmk-workspace-ble/zephyr/soc/nxp/rw/Kconfig"
osource "/home/gomar/Documents/repos/atlas/zmk-workspace-ble/zephyr/soc/nxp/mcx/Kconfig"
osource "/home/gomar/Documents/repos/atlas/zmk-workspace-ble/zephyr/soc/nxp/lpc/Kconfig"
osource "/home/gomar/Documents/repos/atlas/zmk-workspace-ble/zephyr/soc/nxp/layerscape/Kconfig"
osource "/home/gomar/Documents/repos/atlas/zmk-workspace-ble/zephyr/soc/nxp/kinetis/Kconfig"
osource "/home/gomar/Documents/repos/atlas/zmk-workspace-ble/zephyr/soc/nxp/imxrt/Kconfig"
osource "/home/gomar/Documents/repos/atlas/zmk-workspace-ble/zephyr/soc/nxp/imx/Kconfig"
osource "/home/gomar/Documents/repos/atlas/zmk-workspace-ble/zephyr/soc/nuvoton/numicro/Kconfig"
osource "/home/gomar/Documents/repos/atlas/zmk-workspace-ble/zephyr/soc/nuvoton/numaker/Kconfig"
osource "/home/gomar/Documents/repos/atlas/zmk-workspace-ble/zephyr/soc/nuvoton/npcx/Kconfig"
osource "/home/gomar/Documents/repos/atlas/zmk-workspace-ble/zephyr/soc/nuvoton/npcm/Kconfig"
osource "/home/gomar/Documents/repos/atlas/zmk-workspace-ble/zephyr/soc/nordic/Kconfig"
osource "/home/gomar/Documents/repos/atlas/zmk-workspace-ble/zephyr/soc/neorv32/Kconfig"
osource "/home/gomar/Documents/repos/atlas/zmk-workspace-ble/zephyr/soc/native/inf_clock/Kconfig"
osource "/home/gomar/Documents/repos/atlas/zmk-workspace-ble/zephyr/soc/microchip/miv/Kconfig"
osource "/home/gomar/Documents/repos/atlas/zmk-workspace-ble/zephyr/soc/microchip/mec/Kconfig"
osource "/home/gomar/Documents/repos/atlas/zmk-workspace-ble/zephyr/soc/mediatek/mt8xxx/Kconfig"
osource "/home/gomar/Documents/repos/atlas/zmk-workspace-ble/zephyr/soc/lowrisc/opentitan/Kconfig"
osource "/home/gomar/Documents/repos/atlas/zmk-workspace-ble/zephyr/soc/litex/litex_vexriscv/Kconfig"
osource "/home/gomar/Documents/repos/atlas/zmk-workspace-ble/zephyr/soc/ite/ec/Kconfig"
osource "/home/gomar/Documents/repos/atlas/zmk-workspace-ble/zephyr/soc/intel/raptor_lake/Kconfig"
osource "/home/gomar/Documents/repos/atlas/zmk-workspace-ble/zephyr/soc/intel/lakemont/Kconfig"
osource "/home/gomar/Documents/repos/atlas/zmk-workspace-ble/zephyr/soc/intel/intel_socfpga_std/Kconfig"
osource "/home/gomar/Documents/repos/atlas/zmk-workspace-ble/zephyr/soc/intel/intel_socfpga/Kconfig"
osource "/home/gomar/Documents/repos/atlas/zmk-workspace-ble/zephyr/soc/intel/intel_niosv/Kconfig"
osource "/home/gomar/Documents/repos/atlas/zmk-workspace-ble/zephyr/soc/intel/intel_ish/Kconfig"
osource "/home/gomar/Documents/repos/atlas/zmk-workspace-ble/zephyr/soc/intel/intel_adsp/Kconfig"
osource "/home/gomar/Documents/repos/atlas/zmk-workspace-ble/zephyr/soc/intel/elkhart_lake/Kconfig"
osource "/home/gomar/Documents/repos/atlas/zmk-workspace-ble/zephyr/soc/intel/atom/Kconfig"
osource "/home/gomar/Documents/repos/atlas/zmk-workspace-ble/zephyr/soc/intel/apollo_lake/Kconfig"
osource "/home/gomar/Documents/repos/atlas/zmk-workspace-ble/zephyr/soc/intel/alder_lake/Kconfig"
osource "/home/gomar/Documents/repos/atlas/zmk-workspace-ble/zephyr/soc/infineon/cat3/Kconfig"
osource "/home/gomar/Documents/repos/atlas/zmk-workspace-ble/zephyr/soc/infineon/cat1b/Kconfig"
osource "/home/gomar/Documents/repos/atlas/zmk-workspace-ble/zephyr/soc/infineon/cat1a/Kconfig"
osource "/home/gomar/Documents/repos/atlas/zmk-workspace-ble/zephyr/soc/gd/gd32/Kconfig"
osource "/home/gomar/Documents/repos/atlas/zmk-workspace-ble/zephyr/soc/gaisler/leon3/Kconfig"
osource "/home/gomar/Documents/repos/atlas/zmk-workspace-ble/zephyr/soc/gaisler/gr716a/Kconfig"
osource "/home/gomar/Documents/repos/atlas/zmk-workspace-ble/zephyr/soc/espressif/Kconfig"
osource "/home/gomar/Documents/repos/atlas/zmk-workspace-ble/zephyr/soc/ene/kb1200/Kconfig"
osource "/home/gomar/Documents/repos/atlas/zmk-workspace-ble/zephyr/soc/efinix/sapphire/Kconfig"
osource "/home/gomar/Documents/repos/atlas/zmk-workspace-ble/zephyr/soc/cdns/xtensa_sample_controller/Kconfig"
osource "/home/gomar/Documents/repos/atlas/zmk-workspace-ble/zephyr/soc/cdns/sample_controller32/Kconfig"
osource "/home/gomar/Documents/repos/atlas/zmk-workspace-ble/zephyr/soc/cdns/dc233c/Kconfig"
osource "/home/gomar/Documents/repos/atlas/zmk-workspace-ble/zephyr/soc/brcm/bcmvk/Kconfig"
osource "/home/gomar/Documents/repos/atlas/zmk-workspace-ble/zephyr/soc/brcm/bcm2712/Kconfig"
osource "/home/gomar/Documents/repos/atlas/zmk-workspace-ble/zephyr/soc/brcm/bcm2711/Kconfig"
osource "/home/gomar/Documents/repos/atlas/zmk-workspace-ble/zephyr/soc/atmel/sam0/Kconfig"
osource "/home/gomar/Documents/repos/atlas/zmk-workspace-ble/zephyr/soc/atmel/sam/Kconfig"
osource "/home/gomar/Documents/repos/atlas/zmk-workspace-ble/zephyr/soc/aspeed/Kconfig"
osource "/home/gomar/Documents/repos/atlas/zmk-workspace-ble/zephyr/soc/arm/Kconfig"
osource "/home/gomar/Documents/repos/atlas/zmk-workspace-ble/zephyr/soc/arm/beetle/Kconfig"
osource "/home/gomar/Documents/repos/atlas/zmk-workspace-ble/zephyr/soc/antmicro/myra/Kconfig"
osource "/home/gomar/Documents/repos/atlas/zmk-workspace-ble/zephyr/soc/andestech/Kconfig"
osource "/home/gomar/Documents/repos/atlas/zmk-workspace-ble/zephyr/soc/amd/acp_6_0/Kconfig"
osource "/home/gomar/Documents/repos/atlas/zmk-workspace-ble/zephyr/soc/ambiq/Kconfig"
osource "/home/gomar/Documents/repos/atlas/zmk-workspace-ble/zephyr/soc/altr/zephyr_nios2f/Kconfig"
osource "/home/gomar/Documents/repos/atlas/zmk-workspace-ble/zephyr/soc/altr/qemu_nios2/Kconfig"
osource "/home/gomar/Documents/repos/atlas/zmk-workspace-ble/zephyr/soc/adi/max32/Kconfig"
```
