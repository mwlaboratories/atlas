## firmware/ble/config/boards/shields/atlas/Kconfig.defconfig
```kconfig
if SHIELD_ATLAS_LEFT || SHIELD_ATLAS_RIGHT

config ZMK_SPLIT
    default y

# Enable pointing for both sides (both have trackpoints)
config ZMK_POINTING
    default y

endif

if SHIELD_ATLAS_LEFT

# Max 16 characters in keyboard name
config ZMK_KEYBOARD_NAME
    default "ATLAS"

config ZMK_SPLIT_ROLE_CENTRAL
    default y

# Only the right side as peripheral
config ZMK_SPLIT_BLE_CENTRAL_PERIPHERALS
    default 1

# 1 peripheral + 5 BT profiles = 6
config BT_MAX_CONN
    default 6

config BT_MAX_PAIRED
    default 6

endif
```

## zmk-workspace/boards/shields/atlas/Kconfig.defconfig
```kconfig
if SHIELD_ATLAS_LEFT

config ZMK_KEYBOARD_NAME
    default "ATLAS"
    
config ZMK_SPLIT_ROLE_CENTRAL
    default n

endif

if SHIELD_ATLAS_LEFT || SHIELD_ATLAS_RIGHT

config ZMK_SPLIT
    default y

endif
```

## zmk-workspace/boards/shields/atlas/Kconfig.shield
```kconfig
config SHIELD_ATLAS_LEFT
    def_bool $(shields_list_contains,atlas_left)

config SHIELD_ATLAS_RIGHT
    def_bool $(shields_list_contains,atlas_right)
```

## zmk-workspace/config/boards/shields/atlas/Kconfig.defconfig
```kconfig
if SHIELD_ATLAS_LEFT || SHIELD_ATLAS_RIGHT || SHIELD_ATLAS_TRACKBALL

config ZMK_SPLIT
    default y

endif

# Enable pointing for left peripheral, trackball, and dongle
if SHIELD_ATLAS_LEFT || SHIELD_ATLAS_TRACKBALL || SHIELD_ATLAS_DONGLE

config ZMK_POINTING
    default y

endif

if SHIELD_ATLAS_DONGLE

# Max 16 characters in keyboard name
config ZMK_KEYBOARD_NAME
    default "ATLAS"

config ZMK_SPLIT_ROLE_CENTRAL
    default y

config ZMK_SPLIT
    default y

# Set this to the number of peripherals your dongle will have.
# Left + Right + Trackball = 3 peripherals
config ZMK_SPLIT_BLE_CENTRAL_PERIPHERALS
    default 3

# Set this to ZMK_SPLIT_BLE_CENTRAL_PERIPHERALS + your desired number of BT profiles (default is 5)
config BT_MAX_CONN
    default 8

# Set this to the same number as BT_MAX_CONN
config BT_MAX_PAIRED
    default 8

endif
```

## zmk-workspace/config/boards/shields/atlas/Kconfig.shield
```kconfig
config SHIELD_ATLAS_LEFT
    def_bool $(shields_list_contains,atlas_left)

config SHIELD_ATLAS_RIGHT
    def_bool $(shields_list_contains,atlas_right)

config SHIELD_ATLAS_DONGLE
    def_bool $(shields_list_contains,atlas_dongle)

config SHIELD_ATLAS_TRACKBALL
    def_bool $(shields_list_contains,atlas_trackball)
```

## zmk-workspace/config/west.yml
```yaml
manifest:
  remotes:
    - name: zmkfirmware
      url-base: https://github.com/zmkfirmware
    - name: badjeff
      url-base: https://github.com/badjeff
    - name: nrfconnect
      url-base: https://github.com/nrfconnect

  projects:
    - name: zmk
      remote: zmkfirmware
      revision: main
      import: app/west.yml
    - name: kb_zmk_ps2_mouse_trackpoint_driver
      remote: badjeff
      revision: main
    - name: zmk-pmw3610-driver
      remote: badjeff
      revision: main
    - name: zmk-feature-split-esb
      remote: badjeff
      revision: main
    - name: sdk-nrf
      remote: badjeff
      revision: v3.1-branch+zmk-fixes
      path: nrf
    - name: nrfxlib
      remote: nrfconnect
      revision: v3.1-branch
      repo-path: sdk-nrfxlib
      path: nrfxlib
  self:
    path: config
```
