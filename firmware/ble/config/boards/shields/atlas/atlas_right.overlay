#include "atlas.dtsi"

&default_transform {
    col-offset = <5>;
};

&kscan0 {
    interrupt-gpios = <&xiao_d 5 (GPIO_ACTIVE_HIGH | GPIO_PULL_DOWN)>;
    gpios
        = <&xiao_d 7 GPIO_ACTIVE_HIGH>    /* P0 */
        , <&xiao_d 8 GPIO_ACTIVE_HIGH>    /* P1 */
        , <&xiao_d 9 GPIO_ACTIVE_HIGH>    /* P2 */
        , <&xiao_d 10 GPIO_ACTIVE_HIGH>    /* P3 */
        , <&xiao_d 6 GPIO_ACTIVE_HIGH>    /* P4 */
        ;
};

/* ADS1220 trackpoint ADC (SPI): pins per pcb/atlas-*.kicad_pcb (U2); driver = badjeff's module (TODO). */
