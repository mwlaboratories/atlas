#include "atlas.dtsi"

&default_transform {
    col-offset = <5>;
};

&kscan0 {
    row-gpios
        = <&gpio1 3 (GPIO_ACTIVE_HIGH | GPIO_PULL_DOWN)>    /* ROW0  Plus pad 21, P1.03 */
        , <&xiao_d 7 (GPIO_ACTIVE_HIGH | GPIO_PULL_DOWN)>   /* ROW1  D7 */
        , <&xiao_d 6 (GPIO_ACTIVE_HIGH | GPIO_PULL_DOWN)>   /* ROW2  D6 */
        , <&xiao_d 5 (GPIO_ACTIVE_HIGH | GPIO_PULL_DOWN)>   /* ROW3  D5, thumbs */
        ;
    col-gpios
        = <&xiao_d 10 GPIO_ACTIVE_HIGH>                     /* COL0  D10 */
        , <&gpio1 7 GPIO_ACTIVE_HIGH>                       /* COL1  Plus pad 23, P1.07 */
        , <&xiao_d 9 GPIO_ACTIVE_HIGH>                      /* COL2  D9 */
        , <&gpio1 5 GPIO_ACTIVE_HIGH>                       /* COL3  Plus pad 22, P1.05 */
        , <&xiao_d 8 GPIO_ACTIVE_HIGH>                      /* COL4  D8 */
        ;
};

/* ADS1220 strain-gauge pointing (SPI, U2 per pcb/atlas-*.kicad_pcb): not fitted
 * yet, so off. When it is: build with ADS1220=1 (see build-firmware.sh), which
 * adds ads1220.conf + ads1220.overlay next to this file. */
